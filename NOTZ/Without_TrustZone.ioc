# file: Without_TrustZone.ioc
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BOOTPATH.BootPathName=LEGACY
BOOTPATH.UserSelectedBootPath=LEGACY
CORTEX_M33_NS.userName=CORTEX_M33
Mcu.Family=STM32H5
Mcu.Name=STM32H562RGTx
Mcu.Package=LQFP64
NVIC.PriorityGroup=NVIC_PRIORITYGROUP_4
PA13(JTMS/SWDIO).Mode=Serial_Wire
PA13(JTMS/SWDIO).Signal=DEBUG_JTMS-SWDIO
PA14(JTCK/SWCLK).Mode=Serial_Wire
PA14(JTCK/SWCLK).Signal=DEBUG_JTCK-SWCLK
PC14-OSC32_IN(OSC32_IN).Mode=LSE-External-Oscillator
PC14-OSC32_IN(OSC32_IN).Signal=RCC_OSC32_IN
PC15-OSC32_OUT(OSC32_OUT).Mode=LSE-External-Oscillator
PC15-OSC32_OUT(OSC32_OUT).Signal=RCC_OSC32_OUT
PH0-OSC_IN(PH0).Mode=HSE-External-Oscillator
PH0-OSC_IN(PH0).Signal=RCC_OSC_IN
PH1-OSC_OUT(PH1).Mode=HSE-External-Oscillator
PH1-OSC_OUT(PH1).Signal=RCC_OSC_OUT
ProjectManager.HeapSize=0x200
ProjectManager.StackSize=0x400
ProjectManager.TargetToolchain=STM32CubeIDE
RCC.ADCFreq_Value=32000000
RCC.AHBFreq_Value=32000000
RCC.APB1Freq_Value=32000000
RCC.APB1TimFreq_Value=32000000
RCC.APB2Freq_Value=32000000
RCC.APB2TimFreq_Value=32000000
RCC.APB3Freq_Value=32000000
RCC.CSI_VALUE=4000000
RCC.CortexFreq_Value=32000000
RCC.EPOD_VALUE=4000000
RCC.HCLKFreq_Value=32000000
RCC.HSE_VALUE=25000000
RCC.HSI48_VALUE=48000000
RCC.HSI_VALUE=64000000
RCC.LSIRC_VALUE=32000
RCC.SYSCLKFreq_VALUE=32000000
RCC.USBFreq_Value=48000000
RCC.VCOOutputFreq_Value=516000000
VP_BOOTPATH_VS_BOOTPATH.Mode=BP_Activate
VP_CORTEX_M33_NS_VS_Hclk.Mode=Hclk_Mode
VP_CRC_VS_CRC.Mode=CRC_Activate
VP_DCACHE1_VS_DCACHE.Mode=DCACHE_Activate
VP_ICACHE_VS_ICACHE.Mode=DefaultMode
VP_MEMORYMAP_VS_MEMORYMAP.Mode=CurAppReg
VP_PWR_VS_LPOM.Mode=PowerOptimisation
VP_PWR_VS_SECSignals.Mode=Security/Privilege
board=custom

// file: Core/Src/main.c
/* USER CODE BEGIN Header */
/**
  ******************************************************************************
  * @file           : main.c
  * @brief          : Main program body
  ******************************************************************************
  * @attention
  *
  * Copyright (c) 2025 STMicroelectronics.
  * All rights reserved.
  *
  * This software is licensed under terms that can be found in the LICENSE file
  * in the root directory of this software component.
  * If no LICENSE file comes with this software, it is provided AS-IS.
  *
  ******************************************************************************
  */
/* USER CODE END Header */
#include "main.h"

/* USER CODE BEGIN Includes */
#include "string.h"
#include "cmox_crypto.h"
#include "aes_encrypt_decrypt.h"
/* USER CODE END Includes */

CRC_HandleTypeDef hcrc;

DCACHE_HandleTypeDef hdcache1;

void SystemClock_Config(void);
static void MX_GPIO_Init(void);
static void MX_CRC_Init(void);
static void MX_ICACHE_Init(void);
static void MX_DCACHE1_Init(void);

/* USER CODE BEGIN 0 */
#define NUM_TEST_SIZES 10

static const size_t test_sizes[NUM_TEST_SIZES] = {
    4*1024,    // 4 KB
    8*1024,    // 8 KB
    16*1024,   // 16 KB
    24*1024,   // 24 KB
    32*1024,   // 32 KB
    48*1024,   // 48 KB
    64*1024,   // 64 KB
    96*1024,   // 96 KB
    128*1024,  // 128 KB
    192*1024   // 192 KB
};
/* Klucz / IV / AAD testowe */
static const uint8_t AES_Key[AES_KEY_SIZE_256] = {
  0x46,0x3b,0x41,0x29,0x11,0x76,0x7d,0x57,
  0xa0,0xb3,0x39,0x69,0xe6,0x74,0xff,0xe7,
  0x84,0x5d,0x31,0x3b,0x88,0xc6,0xfe,0x31,
  0x2f,0x3d,0x72,0x4b,0xe6,0x8e,0x1f,0xca
};

static const uint8_t AES_IV[AES_IV_SIZE] = {
  0x61,0x1c,0xe6,0xf9,0xa6,0x88,0x07,0x50,0xde,0x7d,0xa6,0xcb
};

static const uint8_t AES_AAD[] = { 0x01, 0x02, 0x03, 0x04 };

typedef struct {
    size_t data_size;
    uint32_t enc_time_ms;
    uint32_t dec_time_ms;
    aes_status_t enc_status;
    aes_status_t dec_status;
    uint8_t verified;
} aes_test_result_t;

static aes_test_result_t aes_results[NUM_TEST_SIZES];

/* ============================ Pomocnicze ============================ */

static void FillBuffer(uint8_t *buf, size_t len)
{
    for (size_t i = 0; i < len; i++)
        buf[i] = (uint8_t)(i & 0xFF);
}

#define MAX_TEST_SIZE (192*1024)  // 192 KB

static uint8_t plaintext[MAX_TEST_SIZE];
static uint8_t ciphertext[MAX_TEST_SIZE + AES_TAG_SIZE];
static uint8_t decrypted[MAX_TEST_SIZE];

/* ============================ Funkcja testująca ============================ */
static void Run_AESEncryptDecrypt_Test(size_t index)
{
    size_t data_size = test_sizes[index];
    size_t enc_len = 0, dec_len = 0;
    uint32_t start, stop;
    aes_status_t status;

    aes_results[index].data_size = data_size;

    FillBuffer(plaintext, data_size);

    /* ============ ENCRYPT ============ */
    start = HAL_GetTick();

#ifdef TRUSTZONE_NONSECURE
    status = SECURE_AES_GCM_Encrypt(
                plaintext, data_size,
                ciphertext, &enc_len);
#else
    status = AES_GCM_Encrypt(
                plaintext, data_size,
                AES_Key, sizeof(AES_Key),
                AES_IV, sizeof(AES_IV),
                AES_AAD, sizeof(AES_AAD),
                ciphertext, &enc_len);
#endif

    stop = HAL_GetTick();
    aes_results[index].enc_time_ms = stop - start;
    aes_results[index].enc_status = status;

    if (status != AES_SUCCESS)
        Error_Handler();

    /* ============ DECRYPT ============ */
    start = HAL_GetTick();

#ifdef TRUSTZONE_NONSECURE
    status = SECURE_AES_GCM_Decrypt(
                ciphertext, enc_len,
                decrypted, &dec_len);
#else
    status = AES_GCM_Decrypt(
                ciphertext, enc_len,
                AES_Key, sizeof(AES_Key),
                AES_IV, sizeof(AES_IV),
                AES_AAD, sizeof(AES_AAD),
                decrypted, &dec_len);
#endif

    stop = HAL_GetTick();
    aes_results[index].dec_time_ms = stop - start;
    aes_results[index].dec_status = status;

    if (status != AES_SUCCESS)
        Error_Handler();

    /* ============ Verify ============ */
    if ((dec_len == data_size) && (memcmp(plaintext, decrypted, data_size) == 0))
        aes_results[index].verified = 1;
    else
        Error_Handler();
}

/* USER CODE END 0 */

int main(void)
{

  /* MCU Configuration--------------------------------------------------------*/

  /* Reset of all peripherals, Initializes the Flash interface and the Systick. */
  HAL_Init();

  /* Configure the system clock */
  SystemClock_Config();

  /* Initialize all configured peripherals */
  MX_GPIO_Init();
//  MX_CRC_Init();
//  MX_ICACHE_Init();
//  MX_DCACHE1_Init();

  /* Infinite loop */
  /* USER CODE BEGIN WHILE */
  /* Init crypto lib */
  if (AES_Crypto_Init() != AES_SUCCESS)
      Error_Handler();

  for (size_t i = 0; i < NUM_TEST_SIZES; i++)
      Run_AESEncryptDecrypt_Test(i);

  AES_Crypto_Finalize();

  while (1)
  {
    /* USER CODE END WHILE */

  }
}

void SystemClock_Config(void)
{
  RCC_OscInitTypeDef RCC_OscInitStruct = {0};
  RCC_ClkInitTypeDef RCC_ClkInitStruct = {0};

  /** Configure the main internal regulator output voltage
  */
  __HAL_PWR_VOLTAGESCALING_CONFIG(PWR_REGULATOR_VOLTAGE_SCALE3);

  while(!__HAL_PWR_GET_FLAG(PWR_FLAG_VOSRDY)) {}

  /** Initializes the RCC Oscillators according to the specified parameters
  * in the RCC_OscInitTypeDef structure.
  */
  RCC_OscInitStruct.OscillatorType = RCC_OSCILLATORTYPE_HSI;
  RCC_OscInitStruct.HSIState = RCC_HSI_ON;
  RCC_OscInitStruct.HSIDiv = RCC_HSI_DIV2;
  RCC_OscInitStruct.HSICalibrationValue = RCC_HSICALIBRATION_DEFAULT;
  RCC_OscInitStruct.PLL.PLLState = RCC_PLL_NONE;
  if (HAL_RCC_OscConfig(&RCC_OscInitStruct) != HAL_OK)
  {
    Error_Handler();
  }

  /** Initializes the CPU, AHB and APB buses clocks
  */
  RCC_ClkInitStruct.ClockType = RCC_CLOCKTYPE_HCLK|RCC_CLOCKTYPE_SYSCLK
                              |RCC_CLOCKTYPE_PCLK1|RCC_CLOCKTYPE_PCLK2
                              |RCC_CLOCKTYPE_PCLK3;
  RCC_ClkInitStruct.SYSCLKSource = RCC_SYSCLKSOURCE_HSI;
  RCC_ClkInitStruct.AHBCLKDivider = RCC_SYSCLK_DIV1;
  RCC_ClkInitStruct.APB1CLKDivider = RCC_HCLK_DIV1;
  RCC_ClkInitStruct.APB2CLKDivider = RCC_HCLK_DIV1;
  RCC_ClkInitStruct.APB3CLKDivider = RCC_HCLK_DIV1;

  if (HAL_RCC_ClockConfig(&RCC_ClkInitStruct, FLASH_LATENCY_1) != HAL_OK)
  {
    Error_Handler();
  }

  /** Configure the programming delay
  */
  __HAL_FLASH_SET_PROGRAM_DELAY(FLASH_PROGRAMMING_DELAY_0);
}

static void MX_CRC_Init(void)
{

  hcrc.Instance = CRC;
  hcrc.Init.DefaultPolynomialUse = DEFAULT_POLYNOMIAL_ENABLE;
  hcrc.Init.DefaultInitValueUse = DEFAULT_INIT_VALUE_ENABLE;
  hcrc.Init.InputDataInversionMode = CRC_INPUTDATA_INVERSION_NONE;
  hcrc.Init.OutputDataInversionMode = CRC_OUTPUTDATA_INVERSION_DISABLE;
  hcrc.InputDataFormat = CRC_INPUTDATA_FORMAT_BYTES;
  if (HAL_CRC_Init(&hcrc) != HAL_OK)
  {
    Error_Handler();
  }

}

static void MX_DCACHE1_Init(void)
{

  hdcache1.Instance = DCACHE1;
  hdcache1.Init.ReadBurstType = DCACHE_READ_BURST_WRAP;
  if (HAL_DCACHE_Init(&hdcache1) != HAL_OK)
  {
    Error_Handler();
  }

}

static void MX_ICACHE_Init(void)
{

  /** Enable instruction cache (default 2-ways set associative cache)
  */
  if (HAL_ICACHE_Enable() != HAL_OK)
  {
    Error_Handler();
  }

}

static void MX_GPIO_Init(void)
{

  /* GPIO Ports Clock Enable */
  __HAL_RCC_GPIOC_CLK_ENABLE();
  __HAL_RCC_GPIOH_CLK_ENABLE();
  __HAL_RCC_GPIOA_CLK_ENABLE();

}

void Error_Handler(void)
{
  __disable_irq();
  while (1)
  {
  }
}
